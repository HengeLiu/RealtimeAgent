## audio-chat/endpoints/esp32-s3/firmware/sdkconfig.defaults
```kconfig
CONFIG_IDF_TARGET="esp32s3"
CONFIG_ESP_MAIN_TASK_STACK_SIZE=8192
CONFIG_ESP_SYSTEM_EVENT_TASK_STACK_SIZE=4096
CONFIG_ESP_WIFI_STATIC_RX_BUFFER_NUM=10
CONFIG_ESP_WIFI_DYNAMIC_RX_BUFFER_NUM=32
CONFIG_ESP_WIFI_DYNAMIC_TX_BUFFER_NUM=32
CONFIG_MBEDTLS_SSL_IN_CONTENT_LEN=16384
CONFIG_MBEDTLS_SSL_OUT_CONTENT_LEN=4096
```

## examples/device_app_demo/esp32-s3/firmware/main/Kconfig.projbuild
```kconfig
menu "Realtime Agent ESP32-S3 Device Demo"

config REALTIME_AGENT_SERVER_URL
    string "Realtime Agent server URL"
    default "http://192.168.10.10:8765"

config REALTIME_AGENT_DEVICE_ID
    string "Device ID"
    default "dev-esp32-s3-001"

config REALTIME_AGENT_USER_ID
    string "User ID"
    default "user-device-demo"

config REALTIME_AGENT_DEVICE_NAME
    string "Device name"
    default "ESP32-S3 Device"

config REALTIME_AGENT_WIFI_SSID
    string "Wi-Fi SSID"
    default ""

config REALTIME_AGENT_WIFI_PASSWORD
    string "Wi-Fi password"
    default ""

config REALTIME_AGENT_AUTO_WAKE_SMOKE
    bool "Auto send wake event after registration for smoke test"
    default n
    help
        Enable this only for protocol smoke testing. The firmware waits until
        the device is registered, delays one second, then sends
        control.user.wake.detected.

endmenu
```

## examples/for-blind-app/devices/native-esp32-glass/firmware/sdkconfig.defaults
```kconfig
# ESP32-S3 默认配置

# Target chip
CONFIG_IDF_TARGET="esp32s3"

# Partition Table
CONFIG_PARTITION_TABLE_CUSTOM=y
CONFIG_PARTITION_TABLE_CUSTOM_FILENAME="partitions.csv"

# Flash Size
CONFIG_ESPTOOLPY_FLASHSIZE_8MB=y

# PSRAM/SPIRAM 配置（用于摄像头帧缓冲区）
# ESP32-S3-WROOM-1-N16R8 使用 Octal PSRAM（8线模式）
CONFIG_SPIRAM=y
CONFIG_SPIRAM_MODE_OCT=y
CONFIG_SPIRAM_TYPE_AUTO=y
CONFIG_SPIRAM_SIZE=-1
CONFIG_SPIRAM_SPEED_80M=y
CONFIG_SPIRAM_BOOT_INIT=y
CONFIG_SPIRAM_USE_MALLOC=y
CONFIG_SPIRAM_MALLOC_ALWAYSINTERNAL=4096
CONFIG_SPIRAM_MALLOC_RESERVE_INTERNAL=8192

# PSRAM Clock and CS IO for ESP32S3
CONFIG_DEFAULT_PSRAM_CLK_IO=30
CONFIG_DEFAULT_PSRAM_CS_IO=26

# 主频设置
CONFIG_ESP_DEFAULT_CPU_FREQ_240=y

# WiFi 配置
CONFIG_ESP_WIFI_STATIC_RX_BUFFER_NUM=16
CONFIG_ESP_WIFI_DYNAMIC_RX_BUFFER_NUM=32
CONFIG_ESP_WIFI_DYNAMIC_TX_BUFFER_NUM=32

# WebSocket 配置
CONFIG_ESP_WEBSOCKET_CLIENT_ENABLED=y
CONFIG_ESP_WEBSOCKET_CLIENT_TASK_STACK_SIZE=4096
CONFIG_ESP_WEBSOCKET_CLIENT_TASK_PRIORITY=5
CONFIG_ESP_WEBSOCKET_CLIENT_NETWORK_TIMEOUT_MS=5000
CONFIG_ESP_WS_CLIENT_SEPARATE_TX_LOCK=y

# 内存配置 - 允许任务栈使用PSRAM
CONFIG_ESP_MAIN_TASK_STACK_SIZE=4096
CONFIG_SPIRAM_ALLOW_STACK_EXTERNAL_MEMORY=y

# 日志配置
CONFIG_LOG_DEFAULT_LEVEL_INFO=y
CONFIG_LOG_MAXIMUM_LEVEL_DEBUG=y

# JSON 支持
CONFIG_JSON_MAX_TOKEN_SIZE=512

# 唤醒词模型 - 启用 "Hi 乐鑫" (wn9_hilexin)
CONFIG_SR_WN_WN9_HILEXIN=y
```

## glass/src/main/Kconfig.projbuild
```kconfig
menu "Glass Runtime Config"

config GLASS_WIFI_PRIMARY_SSID
    string "主 WiFi 名称"
    default ""

config GLASS_WIFI_PRIMARY_PASSWORD
    string "主 WiFi 密码"
    default ""

config GLASS_WIFI_FALLBACK_SSID
    string "兜底 WiFi 名称"
    default ""

config GLASS_WIFI_FALLBACK_PASSWORD
    string "兜底 WiFi 密码"
    default ""

config GLASS_SERVER_WS_URI
    string "服务端控制连接地址"
    default "ws://192.168.1.10:8765/ws/control"

config GLASS_DEVICE_ID
    string "眼镜设备编号"
    default "glass-001"

config GLASS_PAIR_TOKEN
    string "眼镜配对令牌"
    default "pair-demo-token"

config GLASS_FIRMWARE_VERSION
    string "固件版本"
    default "0.1.0"

config GLASS_HEARTBEAT_INTERVAL_MS
    int "设备默认心跳间隔"
    range 1000 60000
    default 5000

endmenu
```

## legacy/openaiglass-sdk/glass-esp32/main/Kconfig.projbuild
```kconfig
menu "Glass Runtime Config"

config GLASS_ENABLE_WAKENET_TEST_APP
    bool "启用独立 WakeNet 测试入口"
    default n
    help
        开启后，main 组件会编译并运行 test_wakenet.c，而不是 glass_main.c。
        该模式只测试唤醒词成功率，不连接服务端，不进行语音对话。

config GLASS_ENABLE_OFFICIAL_AEC_TEST_APP
    bool "启用独立 ESP-SR 官方 AEC 测试入口"
    default n
    help
        开启后，main 组件会编译并运行 test_official_aec.c，而不是 glass_main.c。
        该模式直接使用 ESP32-S3 官方 ESP-SR esp_aec.h，把服务端下发的播放音频同时送入喇叭和 AEC refdata，
        再把 aec_process 输出上传到测试 relay，用来验证端侧 AEC 是否足够可靠。
        请不要和 GLASS_ENABLE_WAKENET_TEST_APP 同时开启；如果同时开启，本测试入口优先。

config GLASS_AEC_TEST_RELAY_WS_URI
    string "ESP-SR AEC 测试 Relay WebSocket 地址"
    default "ws://192.168.1.10:9886/ws"
    depends on GLASS_ENABLE_OFFICIAL_AEC_TEST_APP
    help
        Python 测试 relay 的 WebSocket 地址。建议配合 devtools/omni_esp32_aec_relay.py 使用。

config GLASS_AEC_TEST_FILTER_LENGTH
    int "ESP-SR AEC 滤波长度"
    range 1 8
    default 4
    depends on GLASS_ENABLE_OFFICIAL_AEC_TEST_APP
    help
        传给 aec_create 的 filter_length。官方建议默认 4；值越大资源消耗越高。

choice GLASS_AEC_TEST_MODE
    prompt "ESP-SR AEC 工作模式"
    default GLASS_AEC_TEST_MODE_SR_LOW_COST
    depends on GLASS_ENABLE_OFFICIAL_AEC_TEST_APP

config GLASS_AEC_TEST_MODE_SR_LOW_COST
    bool "语音识别低资源模式"

config GLASS_AEC_TEST_MODE_SR_HIGH_PERF
    bool "语音识别高性能模式"

config GLASS_AEC_TEST_MODE_VOIP_LOW_COST
    bool "通话低资源模式"

config GLASS_AEC_TEST_MODE_VOIP_HIGH_PERF
    bool "通话高性能模式"

endchoice

config GLASS_AEC_TEST_PLAYBACK_GAIN_PERMILLE
    int "ESP-SR AEC 测试播放音量"
    range 50 1500
    default 700
    depends on GLASS_ENABLE_OFFICIAL_AEC_TEST_APP
    help
        播放下行音频时的增益，单位为千分比。默认 700 表示 0.7 倍，避免扬声器过响造成非线性失真。

choice GLASS_AEC_TEST_SPK_FORMAT
    prompt "ESP-SR AEC 测试扬声器 I2S 格式"
    default GLASS_AEC_TEST_SPK_FORMAT_32BIT_MSB_SHIFTED
    depends on GLASS_ENABLE_OFFICIAL_AEC_TEST_APP

config GLASS_AEC_TEST_SPK_FORMAT_32BIT_MSB_SHIFTED
    bool "32-bit stereo MSB, PCM16 左移 16 位"

config GLASS_AEC_TEST_SPK_FORMAT_16BIT_STEREO
    bool "16-bit stereo MSB, PCM16 原样输出"

config GLASS_AEC_TEST_SPK_FORMAT_32BIT_MSB_RAW
    bool "32-bit stereo MSB, PCM16 不左移"

endchoice

config GLASS_AEC_TEST_LOCAL_TONE_ONLY
    bool "只播放本地测试音"
    default n
    depends on GLASS_ENABLE_OFFICIAL_AEC_TEST_APP
    help
        开启后不连接 WiFi、不连接 Omni relay，只通过同一条 I2S 扬声器路径循环播放本地正弦测试音。
        用于隔离排查电流音、爆破音是否来自 ESP32 I2S/功放输出链路。

config GLASS_AEC_TEST_LOCAL_TONE_HZ
    int "本地测试音频率"
    range 100 3000
    default 440
    depends on GLASS_ENABLE_OFFICIAL_AEC_TEST_APP && GLASS_AEC_TEST_LOCAL_TONE_ONLY
    help
        本地测试音频率，默认 440Hz。测试时应听到稳定、干净、无爆破的纯音。

config GLASS_WIFI_PRIMARY_SSID
    string "主 WiFi 名称"
    default ""

config GLASS_WIFI_PRIMARY_PASSWORD
    string "主 WiFi 密码"
    default ""

config GLASS_WIFI_FALLBACK_SSID
    string "兜底 WiFi 名称"
    default ""

config GLASS_WIFI_FALLBACK_PASSWORD
    string "兜底 WiFi 密码"
    default ""

config GLASS_SERVER_WS_URI
    string "服务端控制连接地址"
    default "ws://192.168.1.10:8765/ws/control"

config GLASS_DEVICE_ID
    string "眼镜设备编号"
    default "glass-001"

config GLASS_PAIR_TOKEN
    string "眼镜配对令牌"
    default "pair-demo-token"

config GLASS_FIRMWARE_VERSION
    string "固件版本"
    default "0.1.0"

config GLASS_HEARTBEAT_INTERVAL_MS
    int "设备默认心跳间隔"
    range 1000 60000
    default 5000

config GLASS_WAKE_PROMPT_TONE_ENABLE
    bool "启用唤醒成功提示音"
    default y
    help
        开启后，真实眼镜在 WakeNet 首次唤醒成功时本地播放一个短促轻提示音。
        连续对话窗口内由 VAD 触发的后续语音段不会重复播放提示音。

config GLASS_WAKE_PROMPT_TONE_DURATION_MS
    int "唤醒提示音时长"
    range 20 300
    default 70
    depends on GLASS_WAKE_PROMPT_TONE_ENABLE
    help
        提示音持续时间，单位毫秒。建议保持短促，避免干扰后续用户语音。

config GLASS_WAKE_PROMPT_TONE_FREQ_HZ
    int "唤醒提示音频率"
    range 400 3000
    default 1760
    depends on GLASS_WAKE_PROMPT_TONE_ENABLE
    help
        提示音主频，单位 Hz。

config GLASS_WAKE_PROMPT_TONE_GAIN_PERMILLE
    int "唤醒提示音音量"
    range 20 500
    default 120
    depends on GLASS_WAKE_PROMPT_TONE_ENABLE
    help
        提示音振幅，单位为千分比。默认 120 表示轻提示，避免过响。

endmenu
```

## legacy/openaiglass-sdk/glass-esp32/sdkconfig.defaults
```kconfig
CONFIG_IDF_TARGET="esp32s3"
CONFIG_ESPTOOLPY_FLASHSIZE_8MB=y
CONFIG_ESPTOOLPY_FLASHSIZE="8MB"

CONFIG_PARTITION_TABLE_CUSTOM=y
CONFIG_PARTITION_TABLE_CUSTOM_FILENAME="partitions.csv"
CONFIG_PARTITION_TABLE_FILENAME="partitions.csv"

CONFIG_ESP32S3_SPIRAM_SUPPORT=y
CONFIG_SPIRAM=y
CONFIG_SPIRAM_BOOT_INIT=y
CONFIG_SPIRAM_MODE_OCT=y
CONFIG_SPIRAM_TYPE_ESPPSRAM64=y
CONFIG_SPIRAM_SPEED_80M=y
CONFIG_SPIRAM_IGNORE_NOTFOUND=y
CONFIG_SPIRAM_USE_MALLOC=y
CONFIG_SPIRAM_ALLOW_STACK_EXTERNAL_MEMORY=y
CONFIG_SPIRAM_MALLOC_ALWAYSINTERNAL=4096
CONFIG_SPIRAM_MALLOC_RESERVE_INTERNAL=32768

# ESP32-S3 眼镜开发板通过 USB Serial/JTAG 连接电脑调试。
# 将应用 console 放到 USB Serial/JTAG，避免只能看到 bootloader 而看不到 app 日志。
CONFIG_ESP_CONSOLE_USB_SERIAL_JTAG=y
CONFIG_ESP_CONSOLE_SECONDARY_NONE=y

CONFIG_MODEL_IN_FLASH=y
CONFIG_USE_AFE=y
CONFIG_AFE_INTERFACE_V1=y
CONFIG_USE_WAKENET=y
CONFIG_SR_WN_WN9_HILEXIN=y
CONFIG_GLASS_WAKE_PROMPT_TONE_ENABLE=y
CONFIG_GLASS_WAKE_PROMPT_TONE_DURATION_MS=70
CONFIG_GLASS_WAKE_PROMPT_TONE_FREQ_HZ=1760
CONFIG_GLASS_WAKE_PROMPT_TONE_GAIN_PERMILLE=120
```

## openaiglass-sdk/glass-esp32/main/Kconfig.projbuild
```kconfig
menu "Glass Runtime Config"

config GLASS_ENABLE_WAKENET_TEST_APP
    bool "启用独立 WakeNet 测试入口"
    default n
    help
        开启后，main 组件会编译并运行 test_wakenet.c，而不是 glass_main.c。
        该模式只测试唤醒词成功率，不连接服务端，不进行语音对话。

config GLASS_WIFI_PRIMARY_SSID
    string "主 WiFi 名称"
    default ""

config GLASS_WIFI_PRIMARY_PASSWORD
    string "主 WiFi 密码"
    default ""

config GLASS_WIFI_FALLBACK_SSID
    string "兜底 WiFi 名称"
    default ""

config GLASS_WIFI_FALLBACK_PASSWORD
    string "兜底 WiFi 密码"
    default ""

config GLASS_SERVER_WS_URI
    string "服务端控制连接地址"
    default "ws://192.168.1.10:8765/ws/control"

config GLASS_DEVICE_ID
    string "眼镜设备编号"
    default "glass-001"

config GLASS_PAIR_TOKEN
    string "眼镜配对令牌"
    default "pair-demo-token"

config GLASS_FIRMWARE_VERSION
    string "固件版本"
    default "0.1.0"

config GLASS_HEARTBEAT_INTERVAL_MS
    int "设备默认心跳间隔"
    range 1000 60000
    default 5000

config GLASS_ENABLE_AEC
    bool "启用播放中插话 AEC"
    default y
    help
        开启后，语音前端使用 MIC+播放参考信号进行 AEC，并允许 Omni 连续对话窗口在播放期间继续监听。
        如果板子内存不足，或扬声器参考信号无法稳定同步，可关闭该选项回退半双工播放。

config GLASS_AEC_REFERENCE_BUFFER_MS
    int "AEC 播放参考缓冲时长"
    range 200 3000
    default 1200
    depends on GLASS_ENABLE_AEC
    help
        保存最近一段下行播放 PCM 作为 AEC 参考信号，单位毫秒。
        过短会导致回声参考不足；过长会增加内存占用。

config GLASS_BARGE_IN_GRACE_MS
    int "播放开始后的插话保护窗"
    range 0 3000
    default 900
    depends on GLASS_ENABLE_AEC
    help
        播放首段音频真正写入扬声器后的短暂保护窗，单位毫秒。
        保护窗内忽略 AEC/VAD 的播放中语音触发，避免播放起始瞬态或回声参考未收敛时把扬声器声音误判为用户插话。

config GLASS_BARGE_IN_MIN_SPEECH_FRAMES
    int "播放中插话最小连续语音帧数"
    range 1 30
    default 6
    depends on GLASS_ENABLE_AEC
    help
        保护窗结束后，VAD 需要连续命中多少帧才认为是真实用户插话。
        帧长由 ESP-SR AFE 决定，当前配置约 32ms 一帧；默认 6 帧约等于 192ms。

config GLASS_WAKE_PROMPT_TONE_ENABLE
    bool "启用唤醒成功提示音"
    default y
    help
        开启后，真实眼镜在 WakeNet 首次唤醒成功时本地播放一个短促轻提示音。
        连续对话窗口内由 VAD 触发的后续语音段不会重复播放提示音。

config GLASS_WAKE_PROMPT_TONE_DURATION_MS
    int "唤醒提示音时长"
    range 20 300
    default 70
    depends on GLASS_WAKE_PROMPT_TONE_ENABLE
    help
        提示音持续时间，单位毫秒。建议保持短促，避免干扰后续用户语音。

config GLASS_WAKE_PROMPT_TONE_FREQ_HZ
    int "唤醒提示音频率"
    range 400 3000
    default 1760
    depends on GLASS_WAKE_PROMPT_TONE_ENABLE
    help
        提示音主频，单位 Hz。

config GLASS_WAKE_PROMPT_TONE_GAIN_PERMILLE
    int "唤醒提示音音量"
    range 20 500
    default 120
    depends on GLASS_WAKE_PROMPT_TONE_ENABLE
    help
        提示音振幅，单位为千分比。默认 120 表示轻提示，避免过响。

endmenu
```

## openaiglass-sdk/glass-esp32/sdkconfig.defaults
```kconfig
CONFIG_IDF_TARGET="esp32s3"
CONFIG_ESPTOOLPY_FLASHSIZE_8MB=y
CONFIG_ESPTOOLPY_FLASHSIZE="8MB"

CONFIG_PARTITION_TABLE_CUSTOM=y
CONFIG_PARTITION_TABLE_CUSTOM_FILENAME="partitions.csv"
CONFIG_PARTITION_TABLE_FILENAME="partitions.csv"

CONFIG_ESP32S3_SPIRAM_SUPPORT=y
CONFIG_SPIRAM=y
CONFIG_SPIRAM_BOOT_INIT=y
CONFIG_SPIRAM_MODE_OCT=y
CONFIG_SPIRAM_TYPE_ESPPSRAM64=y
CONFIG_SPIRAM_SPEED_80M=y
CONFIG_SPIRAM_IGNORE_NOTFOUND=y

CONFIG_MODEL_IN_FLASH=y
CONFIG_USE_AFE=y
CONFIG_AFE_INTERFACE_V1=y
CONFIG_USE_WAKENET=y
CONFIG_SR_WN_WN9_HILEXIN=y
CONFIG_GLASS_ENABLE_AEC=y
CONFIG_GLASS_AEC_REFERENCE_BUFFER_MS=1200
CONFIG_GLASS_WAKE_PROMPT_TONE_ENABLE=y
CONFIG_GLASS_WAKE_PROMPT_TONE_DURATION_MS=70
CONFIG_GLASS_WAKE_PROMPT_TONE_FREQ_HZ=1760
CONFIG_GLASS_WAKE_PROMPT_TONE_GAIN_PERMILLE=120
```

## openaiglass-sdk/glass-esp32/sdkconfig.defaults.official_aec_test
```kconfig
# 独立 ESP-SR 官方 AEC 试验入口。
# 使用方式：
# uv run openaiglass.glass.start --sdkconfig-defaults openaiglass-sdk/glass-esp32/sdkconfig.defaults.official_aec_test
CONFIG_IDF_TARGET="esp32s3"
CONFIG_ESPTOOLPY_FLASHSIZE_8MB=y
CONFIG_ESPTOOLPY_FLASHSIZE="8MB"

CONFIG_PARTITION_TABLE_CUSTOM=y
CONFIG_PARTITION_TABLE_CUSTOM_FILENAME="partitions.csv"
CONFIG_PARTITION_TABLE_FILENAME="partitions.csv"

CONFIG_ESP32S3_SPIRAM_SUPPORT=y
CONFIG_SPIRAM=y
CONFIG_SPIRAM_BOOT_INIT=y
CONFIG_SPIRAM_MODE_OCT=y
CONFIG_SPIRAM_TYPE_ESPPSRAM64=y
CONFIG_SPIRAM_SPEED_80M=y
CONFIG_SPIRAM_IGNORE_NOTFOUND=y

CONFIG_ESP_CONSOLE_USB_SERIAL_JTAG=y
CONFIG_ESP_CONSOLE_SECONDARY_NONE=y

CONFIG_MODEL_IN_FLASH=y
CONFIG_USE_AFE=y
CONFIG_AFE_INTERFACE_V1=y
CONFIG_USE_WAKENET=y
CONFIG_SR_WN_WN9_HILEXIN=y

CONFIG_GLASS_ENABLE_OFFICIAL_AEC_TEST_APP=y
CONFIG_GLASS_ENABLE_WAKENET_TEST_APP=n
CONFIG_GLASS_AEC_TEST_FILTER_LENGTH=4
CONFIG_GLASS_AEC_TEST_MODE_SR_LOW_COST=y
CONFIG_GLASS_AEC_TEST_PLAYBACK_GAIN_PERMILLE=500
```
